## conf/machine/appkit-e6.conf
```bitbake
# Copyright (C) 2025 Alif Semiconductor - All Rights Reserved.
# Use, distribution and modification of this code is permitted under the
# terms stated in the Alif Semiconductor Software License Agreement
#
# You should have received a copy of the Alif Semiconductor Software
# License Agreement with this file. If not, please write to:
# contact@alifsemi.com, or visit: https://alifsemi.com/license

# Include architecture-specific tuning for Cortex-A32
require ${ALIF_MSD_BASE}/conf/machine/include/arm/armv8a/tune-cortexa32.inc

DEFAULTTUNE = "cortexa32"

# Platform-specific settings
TF-A_PLATFORM = "devkit_e7"
BL32_IN_XIP_MEM ?= "1"
BL32_XIP_BASE ?= "0x80002000"
A32_HWSEM_MST_ID ?= "0xA1B2C3D4"
UART ??= "2"
SMP:forcevariable = "0"
BASE_IMAGE ??= "1"
BASE_IMAGE2 ??= "0"
BASE_IMAGE3 ??= "0"
BASE_IMAGE4 ??= "0"
BASE_IMAGE5 ??= "0"
BASE_IMAGE7 ??= "0"

# Common memory addresses
KERNEL_XIP_DEFAULT ?= "${@bb.utils.contains('DISTRO_FEATURES', 'apss-mipicsi', '0x02300000', '0x02000000', d)}"
KERNEL_XIP_HYPRAM ?= "0xA0000000"

# HYPRAM settings
HYPRAM_ONLY ??= "${@'0' if d.getVar('BASE_IMAGE3') == '1' or d.getVar('BASE_IMAGE4') == '1' or d.getVar('BASE_IMAGE5') == '1' or d.getVar('BASE_IMAGE7') == '1' else '1' if d.getVar('BASE_IMAGE2') == '1' else ''}"

KERNEL_XIP_RAM ?= "${@KERNEL_XIP_HYPRAM if d.getVar('HYPRAM_ONLY') == '1' else KERNEL_XIP_DEFAULT }"
AP_HYPERRAM_EN ??= "${@'1' if d.getVar('HYPRAM_ONLY') == '1' or d.getVar('HYPRAM_ONLY') == '0' else '0'}"
ISSI_HYPERRAM_EN ??= "0"

# Boot from OSPI (set to 1 if needed)
OSPI_BOOT ??= "${@'1' if d.getVar('BASE_IMAGE3') == '1' or d.getVar('BASE_IMAGE7') == '1' else '0'}"
OSPI_BOOT_ENC ??= "0"
MX_FLASH_EN ??= "${@'1' if d.getVar('BASE_IMAGE2') == '1' else '0'}"
ISSI_FLASH_EN ??= "0"
# appkit-e6 uses 16-bit AP Memory
AP_MEMORY_BUS_WIDTH ??= "${@'16' if d.getVar('AP_HYPERRAM_EN') == '1' else '0'}"

# Include OSPI configuration files if enabled
include ${@bb.utils.contains('OSPI_BOOT', '1', 'conf/machine/include/ospi-config.inc','', d)}
include ${@bb.utils.contains('OSPI_BOOT_ENC', '1', 'conf/machine/include/ospi-enc-config.inc','', d)}

# Flash and encryption settings
AES_EN ??= "0"
AES_ENC_KEY ??= ""

ADC_MODE ??= "0"

# Trusted SRAM base address
ALIF_TRUSTED_SRAM_BASE ??= "0x027DE000"

# E6 is not Ensemble E8 — skip E8-only OSPI/NPU-HG register programming in BL32
ALIF_SOC_E8 ??= "0"

# TF-A options
TF-A_EXTRA_OPTIONS += " \
            RESET_TO_SP_MIN=1 \
            ARM_LINUX_KERNEL_AS_BL33=1 \
            PRELOADED_BL33_BASE=${XIP_KERNEL_LOAD_ADDR} \
            ARM_PRELOADED_DTB_BASE=${KERNEL_DTB_ADDR} \
            ALIF_TRUSTED_SRAM_BASE=${ALIF_TRUSTED_SRAM_BASE} \
            BL32_IN_XIP_MEM=${BL32_IN_XIP_MEM} \
            ALIF_BL32_XIP_BASE=${BL32_XIP_BASE} \
            ALIF_SOC_E8=${ALIF_SOC_E8} \
            AP_HYPERRAM_EN=${AP_HYPERRAM_EN} \
            ISSI_HYPERRAM_EN=${ISSI_HYPERRAM_EN} \
            MX_FLASH_EN=${MX_FLASH_EN} \
            ISSI_FLASH_EN=${ISSI_FLASH_EN} \
            AES_EN=${AES_EN} \
            AES_ENC_KEY=${AES_ENC_KEY} \
            UART=${UART} \
	    AP_MEMORY_BUS_WIDTH=${AP_MEMORY_BUS_WIDTH} \
            "

# Kernel image and device tree settings
KERNEL_IMAGETYPE = "xipImage"
KERNEL_DEVICETREE = "alif/ensemble/appkit/appkit-e6.dtb"
KBUILD_DEFCONFIG = "${@bb.utils.contains('SMP', '0', 'appkit_e6_defconfig', 'appkit_e6_defconfig', d)}"
KERNEL_DTB_ADDR ?= "0x80010000"
XIP_KERNEL_LOAD_ADDR ?= "0x80020000"
KERNEL_MTD_START_ADDR ?= "${@'0xC0000000' if d.getVar('BASE_IMAGE2') == '1' else '0x80380000'}"
KERNEL_MTD_LEN ?= "${@'0x400000' if d.getVar('BASE_IMAGE2') == '1' else '200000'}"

# Preferred kernel provider
PREFERRED_PROVIDER_virtual/kernel:forcevariable = "linux-alif"

# DCT tool settings
DTS_MACRO_FILE ?= "/arch/arm/boot/dts/alif/ensemble/common/devkit_ex_dct_defines.h"
DTS_MACRO_FILE_ORG ?= "/arch/arm/boot/dts/alif/ensemble/common/devkit_ex_dct_defines.h.org"

# Serial console settings
SERIAL_CONSOLES ?= "115200;ttyS0 ${@bb.utils.contains('DISTRO_FEATURES', 'apss-debug', '', '115200;ttyS1 115200;ttyS2 115200;ttyS3', d)}"
```

## conf/machine/devkit-e7.conf
```bitbake
# Copyright (C) 2025 Alif Semiconductor - All Rights Reserved.
# Use, distribution and modification of this code is permitted under the
# terms stated in the Alif Semiconductor Software License Agreement
#
# You should have received a copy of the Alif Semiconductor Software
# License Agreement with this file. If not, please write to:
# contact@alifsemi.com, or visit: https://alifsemi.com/license

# Version: 1.0.0
# Last Updated: 2025-07-23
# Author: Jagadeesh Krishnanjanappa <jagadeesh@alifsemi.com>

# Include architecture-specific tuning for Cortex-A32
require ${ALIF_MSD_BASE}/conf/machine/include/arm/armv8a/tune-cortexa32.inc

DEFAULTTUNE = "cortexa32"

# Platform-specific settings
TF-A_PLATFORM = "devkit_e7"
BL32_IN_XIP_MEM ?= "1"
BL32_XIP_BASE ?= "0x80002000"
A32_HWSEM_MST_ID ?= "0xA1B2C3D4"
UART ??= "2"
SMP ?= "1"
BASE_IMAGE ??= "1"

# Common memory addresses
KERNEL_XIP_DEFAULT = "0x02000000"
KERNEL_XIP_HYPRAM = "0xA0000000"

# HYPRAM settings
HYPRAM_ONLY ??= "0"
HYPRAM_STITCH ??= "0"
STITCH_SRAM_ONLY ??= "${@bb.utils.contains('HYPRAM_ONLY','1', '0', '1',d)}"
EVAL_KERNEL_XIP_RAM ?= "${@bb.utils.contains('HYPRAM_ONLY', '1', KERNEL_XIP_HYPRAM, KERNEL_XIP_DEFAULT, d)}"
KERNEL_XIP_RAM ?= "${@ '0x02000000' if d.getVar('STITCH_SRAM_ONLY') == '1' else '0x02000000' if d.getVar('HYPRAM_STITCH') == '1' else d.getVar('EVAL_KERNEL_XIP_RAM') }"
HYPRAM_EN ??= "${@'1' if d.getVar('HYPRAM_STITCH') == '1' or d.getVar('HYPRAM_ONLY') == '1' else '0'}"

# Boot from OSPI (set to 1 if needed)
OSPI_BOOT ??= "0"
OSPI_BOOT_ENC ??= "0"

# Include OSPI configuration files if enabled
include ${@bb.utils.contains('OSPI_BOOT', '1', 'conf/machine/include/ospi-config.inc','', d)}
include ${@bb.utils.contains('OSPI_BOOT_ENC', '1', 'conf/machine/include/ospi-enc-config.inc','', d)}

# Flash and encryption settings
FLASH_EN ??= "0"
AES_EN ??= "0"
AES_ENC_KEY ??= ""

# Trusted SRAM base address
ALIF_TRUSTED_SRAM_BASE ??= "0x027DE000"

# TF-A options
TF-A_EXTRA_OPTIONS += " \
            RESET_TO_SP_MIN=1 \
            ARM_LINUX_KERNEL_AS_BL33=1 \
            PRELOADED_BL33_BASE=${XIP_KERNEL_LOAD_ADDR} \
            ARM_PRELOADED_DTB_BASE=${KERNEL_DTB_ADDR} \
            ALIF_TRUSTED_SRAM_BASE=${ALIF_TRUSTED_SRAM_BASE} \
            BL32_IN_XIP_MEM=${BL32_IN_XIP_MEM} \
            BL32_XIP_BASE=${BL32_XIP_BASE} \
            HYPRAM_EN=${HYPRAM_EN} \
            FLASH_EN=${FLASH_EN} \
            AES_EN=${AES_EN} \
            AES_ENC_KEY=${AES_ENC_KEY} \
            UART=${UART} \
            "

# Kernel image and device tree settings
KERNEL_IMAGETYPE = "xipImage"
KERNEL_DEVICETREE = "alif/devkit-e7.dtb"
KBUILD_DEFCONFIG = "${@bb.utils.contains('SMP', '0', 'devkit_e7_defconfig', 'devkit_e7_defconfig', d)}"
KERNEL_DTB_ADDR ?= "0x80010000"
XIP_KERNEL_LOAD_ADDR ?= "0x80020000"
KERNEL_MTD_START_ADDR ?= "0x80380000"
KERNEL_MTD_LEN ?= "0x200000"

# Preferred kernel provider
PREFERRED_PROVIDER_virtual/kernel:forcevariable = "linux-alif"

# DCT tool settings
DTS_MACRO_FILE ?= "/arch/arm/boot/dts/alif/devkit_ex_dct_defines.h"
DTS_MACRO_FILE_ORG ?= "/arch/arm/boot/dts/alif/devkit_ex_dct_defines.h.org"

# Serial console settings
SERIAL_CONSOLES ?= "115200;ttyS0 ${@bb.utils.contains('DISTRO_FEATURES', 'apss-debug', '', '115200;ttyS1 115200;ttyS2 115200;ttyS3', d)}"
```
