## conf/layer.conf
```bitbake
# Copyright (C) 2024 Alif Semiconductor - All Rights Reserved.
# Use, distribution and modification of this code is permitted under the
# terms stated in the Alif Semiconductor Software License Agreement
#
# You should have received a copy of the Alif Semiconductor Software
# License Agreement with this file. If not, please write to:
# contact@alifsemi.com, or visit: https://alifsemi.com/license

# We have a conf and classes directory, add to BBPATH
BBPATH .= ":${LAYERDIR}"

# We have recipes-* directories, add to BBFILES
BBFILES += "${LAYERDIR}/recipes-*/*/*.bb \
            ${LAYERDIR}/recipes-*/*/*.bbappend"

BBFILE_COLLECTIONS += "meta-alif-ensemble"
BBFILE_PATTERN_meta-alif-ensemble = "^${LAYERDIR}/"
BBFILE_PRIORITY_meta-alif-ensemble = "6"

LAYERDEPENDS_meta-alif-ensemble = "core"
LAYERSERIES_COMPAT_meta-alif-ensemble = "warrior zeus"
ALIF_MSD_BASE = '${@os.path.normpath("${LAYERDIR}/")}'
LICENSE_PATH += "${LAYERDIR}/licenses"
```

## conf/machine/devkit-e5.conf
```bitbake
# Copyright (C) 2024 Alif Semiconductor - All Rights Reserved.
# Use, distribution and modification of this code is permitted under the
# terms stated in the Alif Semiconductor Software License Agreement
#
# You should have received a copy of the Alif Semiconductor Software
# License Agreement with this file. If not, please write to:
# contact@alifsemi.com, or visit: https://alifsemi.com/license

require conf/machine/include/tune-cortex-a32.inc

DEFAULTTUNE = "cortexa32hf-neon"

# Boot xipImage and cramfs-xip from OSPI1
OSPI_BOOT ??= "0"
OSPI_BOOT_ENC ??= "0"
include ${@bb.utils.contains('OSPI_BOOT', '1', 'conf/machine/include/ospi-config.inc','', d)}
include ${@bb.utils.contains('OSPI_BOOT_ENC', '1', 'conf/machine/include/ospi-enc-config.inc','', d)}

# Use underscore "_" in platform name, - does not support
TF-A_PLATFORM = "devkit_e7"
BL32_IN_XIP_MEM ?= "1"
BL32_XIP_BASE ?= "0x80002000"
HYPRAM_AS_LOWMEM ??= "0"
TRUSTED_SRAM1 ?= "0x08000000"
KERNEL_XIP_RAM ?= "${@bb.utils.contains('HYPRAM_AS_LOWMEM', '1', '0xA0000000', '0x02000000', d)}"
KERNEL_DTB_ADDR ?= "0x80010000"
XIP_KERNEL_LOAD_ADDR ?= "0x80020000"
KERNEL_MTD_START_ADDR ?= "0x80380000"
KERNEL_MTD_LEN ?= "0x200000"
A32_HWSEM_MST_ID ?= "0xA1B2C3D4"
UART ??= "2"
HYPRAM_EN ??= "1"
FLASH_EN ??= "0"
AES_EN ??= "0"
AES_ENC_KEY ??=""
RAM_PRELOADED_DTB_BASE ??= "${@bb.utils.contains('HYPRAM_AS_LOWMEM','1', '0xA0390000', '0x02390000',d)}"
SMP = "0"
BASE_IMAGE ??= "0"

TF-A_EXTRA_OPTIONS += " \
			RESET_TO_SP_MIN=1 \
			ARM_LINUX_KERNEL_AS_BL33=1 \
			ARM_TRUSTED_SRAM_BASE=${TRUSTED_SRAM1} \
			PRELOADED_BL33_BASE=${XIP_KERNEL_LOAD_ADDR} \
			ARM_PRELOADED_DTB_BASE=${KERNEL_DTB_ADDR} \
			RAM_PRELOADED_DTB_BASE=${RAM_PRELOADED_DTB_BASE} \
			ENABLE_STACK_PROTECTOR=strong \
			ENABLE_PIE=1 \
			BL32_IN_XIP_MEM=${BL32_IN_XIP_MEM} \
			BL32_XIP_BASE=${BL32_XIP_BASE} \
			UART=${UART} \
			HYPRAM_EN=${HYPRAM_EN} FLASH_EN=${FLASH_EN} \
			AES_EN=${AES_EN} AES_ENC_KEY="${AES_ENC_KEY}" \
			"
KERNEL_IMAGETYPE = "xipImage"
KERNEL_DEVICETREE = "devkit-e5.dtb"
KBUILD_DEFCONFIG = "devkit_e5_defconfig"

PREFERRED_PROVIDER_virtual/kernel_forcevariable = "linux-alif"

# needed for DCT tool
DTS_MACRO_FILE ?= "/arch/arm/boot/dts/devkit_e5_dct_defines.h"
DTS_MACRO_FILE_ORG ?= "/arch/arm/boot/dts/devkit_e5_dct_defines.h.org"

SERIAL_CONSOLES ?= "115200;ttyS0 ${@bb.utils.contains('DISTRO_FEATURES', 'apss-debug', '', '115200;ttyS1 115200;ttyS2 115200;ttyS3', d)}"
```
